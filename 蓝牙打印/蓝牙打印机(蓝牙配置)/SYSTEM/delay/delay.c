#include "delay.h"

/******************************************************************
*函数功能  ：滴答定时器初始化
*函数名    ：SysTick_Init
*函数参数  ：void
*函数返回值：void
*描述      ：
*******************************************************************/
void SysTick_Init(void)
{
  //选择时钟源     写0是外部时钟源   写1是内部时钟源
  SysTick->CTRL &= ~(1<<2);
}

/******************************************************************
*函数功能  ：系统滴答定时器微秒延时
*函数名    ：delay_us
*函数参数  ：u32 us
*函数返回值：void
*描述      ：
*******************************************************************/
void delay_us(u32 us)
{
  //将当前值寄存器清零   //随便写一个数据进入
  SysTick->VAL = 0xff;
  //将要计时的数据写入到重装载值寄存器
  SysTick->LOAD = 9*us;
  //开始计数             //开计数器使能
  SysTick->CTRL |= (1<<0);
  //等待计数完成         //while(16位为0)
  while(!(SysTick->CTRL & (1<<16)));
  //关闭计数器
  SysTick->CTRL &= ~(1<<0);
}


/******************************************************************
*函数功能  ：系统滴答定时器微秒延时
*函数名    ：delay1_ms
*函数参数  ：u16 ms
*函数返回值：void
*描述      ：
*******************************************************************/
void delay1_ms(u16 ms)
{
  //将当前值寄存器清零   //随便写一个数据进入
  SysTick->VAL = 0xff;
  //将要计时的数据写入到重装载值寄存器
  SysTick->LOAD = 9*1000*ms;
  //开始计数             //开计数器使能
  SysTick->CTRL |= (1<<0);
  //等待计数完成         //while(16位为0)
  while(!(SysTick->CTRL & (1<<16)));
  //关闭计数器
  SysTick->CTRL &= ~(1<<0);
}

/******************************************************************
*函数功能  ：系统滴答定时器微秒延时(修改版)
*函数名    ：delay_ms
*函数参数  ：u16 ms
*函数返回值：void
*描述      ：
*******************************************************************/
void delay_ms(u16 ms)
{
  u8 i,n=0;
  if(ms <= 1864)
  {
    delay1_ms(ms);
  }
  else
  {
    while(ms >= 1864)
    {
      ms -= 1864;
      n++;
    }
    for(i=0;i<n;i++) delay1_ms(1864);
    delay1_ms(ms);
  }
}

/******************************************************************
*函数功能  ：滴答定时器初始化(需要用到中断)
*函数名    ：SysTick1_Init
*函数参数  ：u16 ms
*函数返回值：void
*描述      ：
*******************************************************************/
void SysTick1_Init(u16 ms)
{
  u8 pri;
  
  /*滴答定时器配置*/
  //时钟源选择           //控制及状态寄存器的2位写 0外部时钟
  SysTick->CTRL &= ~(1<<2);
  //开启中断使能
  SysTick->CTRL |= (1<<1);
  //将当前值寄存器清零   //随便写一个数据进入
  SysTick->VAL = 0xff;
  //将要计时的数据写入到重装载值寄存器
  SysTick->LOAD = 9000*ms;
  
  /*NVIC寄存器配置*/
    //中断分组（在主函数）
  //计算中断优先级编码中断
  pri = NVIC_EncodePriority (5, 1, 1); 
  //将编码写入中断源
  NVIC_SetPriority(SysTick_IRQn,pri);
  
  //开始计数             //开计数器使能 
  SysTick->CTRL |= (1<<0);
}








